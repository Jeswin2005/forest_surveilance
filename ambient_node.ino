/*
 * ============================================================
 * AMBIENT NODE — Forest Audio & Environmental Surveillance
 * ============================================================
 * HARDWARE REQUIRED:
 *   - ESP32 Development Board (38-pin or 30-pin)
 *   - INMP441 I2S Microphone
 *   - DHT11 Temperature & Humidity Sensor
 *   - MQ2 Gas Sensor
 *   - SX1276/SX1278 LoRa Module
 *
 * ============================================================
 * COMPLETE WIRING DIAGRAM
 * ============================================================
 *
 * --- INMP441 I2S MICROPHONE ---
 *   INMP441 VDD  → ESP32 3.3V
 *   INMP441 GND  → ESP32 GND
 *   INMP441 WS   → ESP32 GPIO 25
 *   INMP441 SD   → ESP32 GPIO 33
 *   INMP441 SCK  → ESP32 GPIO 26
 *   INMP441 L/R  → ESP32 GND  (selects left channel)
 *
 * --- DHT11 SENSOR ---
 *   DHT11 VCC    → ESP32 3.3V
 *   DHT11 GND    → ESP32 GND
 *   DHT11 DATA   → ESP32 GPIO 4
 *   (Add 10K resistor between VCC and DATA if readings fail)
 *
 * --- MQ2 GAS SENSOR ---
 *   MQ2 VCC      → ESP32 5V  (needs 5V for heater)
 *   MQ2 GND      → ESP32 GND
 *   MQ2 AOUT     → ESP32 GPIO 34
 *   (Wait 2 minutes after power-on for MQ2 to warm up)
 *
 * --- SX1276/SX1278 LoRa MODULE ---
 *   LoRa VCC     → ESP32 3.3V
 *   LoRa GND     → ESP32 GND
 *   LoRa MOSI    → ESP32 GPIO 23
 *   LoRa MISO    → ESP32 GPIO 19
 *   LoRa SCK     → ESP32 GPIO 18
 *   LoRa NSS/CS  → ESP32 GPIO 5
 *   LoRa RST     → ESP32 GPIO 14
 *   LoRa DIO0    → ESP32 GPIO 2
 *   LoRa DIO1    → NOT CONNECTED
 *   LoRa DIO2    → NOT CONNECTED
 *
 * ============================================================
 * ARDUINO IDE SETTINGS
 * ============================================================
 *   Board            : ESP32 Dev Module
 *   Partition Scheme : Default (or Huge APP if model too big)
 *   PSRAM            : Enabled (if your board has PSRAM)
 *   Upload Speed     : 115200
 *   Flash Size       : 4MB
 *
 * ============================================================
 * LIBRARIES (Install via Arduino Library Manager)
 * ============================================================
 *   - LoRa                by Sandeep Mistry
 *   - DHT sensor library  by Adafruit
 *   - Adafruit Unified Sensor by Adafruit
 *   - arduinoFFT          by kosme
 *   - TensorFlowLite_ESP32 by tanakamasayuki
 *
 * ============================================================
 * FILES NEEDED IN SKETCH FOLDER
 * ============================================================
 *   - ambient_node.ino    (this file)
 *   - acs_audio_crnn.h    (generated by training pipeline)
 * ============================================================
 */

#include <Arduino.h>
#include <SPI.h>
#include <LoRa.h>
#include "DHT.h"
#include <driver/i2s.h>
#include "esp_heap_caps.h"
#include "arduinoFFT.h"

// TFLite Micro
#include "tensorflow/lite/micro/micro_mutable_op_resolver.h"
#include "tensorflow/lite/micro/micro_interpreter.h"
#include "tensorflow/lite/schema/schema_generated.h"
#include "model.h"

// ============================================================
// PIN DEFINITIONS
// ============================================================

// DHT11
#define DHTPIN   4
#define DHTTYPE  DHT11

// MQ2 Gas Sensor
#define MQ2_PIN  34

// LoRa SX1276/SX1278
#define LORA_SS    5
#define LORA_RST  14
#define LORA_DIO0  2
#define LORA_FREQ  433E6   // change to 868E6 or 915E6 if needed

// I2S Microphone INMP441
#define I2S_WS   25
#define I2S_SD   33
#define I2S_SCK  26
#define I2S_PORT I2S_NUM_0

// ============================================================
// THRESHOLDS
// ============================================================
#define GAS_THRESHOLD         2000   // MQ2 ADC value — tune after warmup
#define TEMP_THRESHOLD        50.0f  // degrees C — fire detection
#define AUDIO_CONF_THRESH     0.70f  // 70% minimum confidence for alert

// ============================================================
// AUDIO DSP PARAMETERS — must match Python training exactly
// ============================================================
#define SAMPLE_RATE   16000
#define FFT_SAMPLES   512       // matches librosa hop_length=512
#define TIME_STEPS    94        // 48000 / 512 = 93.75 → 94
#define N_MELS        128

double vReal[FFT_SAMPLES];
double vImag[FFT_SAMPLES];
ArduinoFFT<double> FFT = ArduinoFFT<double>(
    vReal, vImag, FFT_SAMPLES, SAMPLE_RATE
);

// ============================================================
// MODEL PARAMETERS
// ============================================================
// Classes must match training order exactly:
// chainsaw=0, environmental=1, gun_shot=2
const char* CLASS_LABELS[3] = {
    "CHAINSAW",
    "ENVIRONMENT",
    "GUN_SHOT"
};

// Tensor arena — 120KB in PSRAM
const int   TENSOR_ARENA_SIZE = 120 * 1024;
uint8_t*    tensor_arena      = nullptr;

const tflite::Model*      tfl_model     = nullptr;
tflite::MicroInterpreter* interpreter   = nullptr;
TfLiteTensor*             input_tensor  = nullptr;
TfLiteTensor*             output_tensor = nullptr;

// ============================================================
// SENSOR DATA STRUCT
// ============================================================
struct NodeData {
    float temperature;
    float humidity;
    int   gas_level;
    bool  fire_alert;
    int   audio_class_id;
    float audio_confidence;
    char  audio_label[16];
};

// ============================================================
// SENSOR INIT
// ============================================================
DHT dht(DHTPIN, DHTTYPE);

void init_sensors() {
    dht.begin();
    pinMode(MQ2_PIN, INPUT);
    Serial.println("[SEN] DHT11 + MQ2 OK");
}

// ============================================================
// LORA INIT
// ============================================================
bool init_lora() {
    LoRa.setPins(LORA_SS, LORA_RST, LORA_DIO0);

    if (!LoRa.begin(LORA_FREQ)) {
        Serial.println("[LORA] Init Failed!");
        return false;
    }
    // Settings AFTER begin()
    LoRa.setSyncWord(0xF3);   // must match gateway
    LoRa.setTxPower(17);      // higher power for regular ESP32
    Serial.println("[LORA] OK");
    return true;
}

// ============================================================
// I2S MICROPHONE INIT
// ============================================================
void init_i2s() {
    i2s_config_t i2s_config = {
        .mode = (i2s_mode_t)(I2S_MODE_MASTER | I2S_MODE_RX),
        .sample_rate          = SAMPLE_RATE,
        .bits_per_sample      = I2S_BITS_PER_SAMPLE_32BIT,
        .channel_format       = I2S_CHANNEL_FMT_ONLY_LEFT,
        .communication_format = i2s_comm_format_t(
            I2S_COMM_FORMAT_I2S | I2S_COMM_FORMAT_I2S_MSB
        ),
        .intr_alloc_flags     = ESP_INTR_FLAG_LEVEL1,
        .dma_buf_count        = 8,
        .dma_buf_len          = 64,
        .use_apll             = false,
        .tx_desc_auto_clear   = false,
        .fixed_mclk           = 0
    };

    i2s_pin_config_t pin_config = {
        .bck_io_num     = I2S_SCK,
        .ws_io_num      = I2S_WS,
        .data_out_num   = I2S_PIN_NO_CHANGE,
        .data_in_num    = I2S_SD
    };

    i2s_driver_install(I2S_PORT, &i2s_config, 0, NULL);
    i2s_set_pin(I2S_PORT, &pin_config);
    Serial.println("[MIC] I2S OK");
}

// ============================================================
// TFLITE INIT — CRNN ops only
// ============================================================
bool init_tflite() {
    // Allocate in PSRAM
    tensor_arena = (uint8_t*)heap_caps_malloc(
        TENSOR_ARENA_SIZE,
        MALLOC_CAP_SPIRAM | MALLOC_CAP_8BIT
    );
    // Fallback to regular heap if no PSRAM
    if (!tensor_arena) {
        Serial.println("[TFL] No PSRAM — trying heap");
        tensor_arena = (uint8_t*)malloc(TENSOR_ARENA_SIZE);
    }
    if (!tensor_arena) {
        Serial.println("[TFL] Arena alloc failed");
        return false;
    }

    tfl_model = tflite::GetModel(crnn_model);
    if (tfl_model->version() != TFLITE_SCHEMA_VERSION) {
        Serial.println("[TFL] Schema mismatch");
        return false;
    }

    // Only register ops used by CRNN (Conv2D + LSTM + Dense)
    static tflite::MicroMutableOpResolver<15> resolver;
    resolver.AddConv2D();
    resolver.AddMaxPool2D();
    resolver.AddReshape();
    resolver.AddConv1D();             // friend used Conv1D
    resolver.AddMean();               // GlobalAveragePooling1D uses Mean
    resolver.AddFullyConnected();
    resolver.AddSoftmax();
    resolver.AddQuantize();
    resolver.AddDequantize();
    resolver.AddBatchNormalization();

    static tflite::MicroInterpreter static_interp(
        tfl_model, resolver, tensor_arena, TENSOR_ARENA_SIZE
    );
    interpreter = &static_interp;

    if (interpreter->AllocateTensors() != kTfLiteOk) {
        Serial.println("[TFL] AllocateTensors failed");
        Serial.println("[TFL] Try increasing TENSOR_ARENA_SIZE");
        return false;
    }

    input_tensor  = interpreter->input(0);
    output_tensor = interpreter->output(0);

    Serial.printf("[TFL] Input: [%d,%d,%d,%d] OK\n",
        input_tensor->dims->data[0],
        input_tensor->dims->data[1],
        input_tensor->dims->data[2],
        input_tensor->dims->data[3]);
    return true;
}

// ============================================================
// DSP — Capture audio + compute mel spectrogram
// Fills input tensor directly
// ============================================================
void capture_and_process_audio() {
    Serial.println("[DSP] Recording 3s...");

    int32_t sampleBuffer[FFT_SAMPLES];
    size_t  bytesRead;
    int     tensor_index = 0;

    // Clear input tensor first
    memset(input_tensor->data.int8, 0, input_tensor->bytes);

    for (int t = 0; t < TIME_STEPS; t++) {

        // 1. Read one FFT_SAMPLES block from I2S mic
        i2s_read(I2S_PORT, &sampleBuffer,
                 sizeof(sampleBuffer), &bytesRead, portMAX_DELAY);

        // 2. Fill FFT input arrays
        for (int i = 0; i < FFT_SAMPLES; i++) {
            vReal[i] = (double)(sampleBuffer[i] >> 8);
            vImag[i] = 0.0;
        }

        // 3. Apply Hanning window + compute FFT
        FFT.windowing(FFTWindow::Hann, FFTDirection::Forward);
        FFT.compute(FFTDirection::Forward);
        FFT.complexToMagnitude();
        // vReal now contains magnitude spectrum (256 useful bins)

        // 4. Map FFT bins to N_MELS mel bins and quantise to INT8
        // Linear approximation of mel filterbank
        // True mel scale would need full filterbank matrix
        for (int m = 0; m < N_MELS; m++) {
            int    start_bin  = m * 2;
            int    end_bin    = start_bin + 2;
            double mel_power  = 0;

            for (int k = start_bin; k < end_bin && k < FFT_SAMPLES/2; k++) {
                mel_power += vReal[k];
            }

            // Log power to dB, normalise, quantise to INT8
            int8_t quantized_mel = -128;
            if (mel_power > 1.0) {
                double db     = 10.0 * log10(mel_power);
                int    scaled = (int)((db / 80.0) * 255.0) - 128;
                quantized_mel = (int8_t)constrain(scaled, -128, 127);
            }

            if (tensor_index < input_tensor->bytes) {
                input_tensor->data.int8[tensor_index++] = quantized_mel;
            }
        }
    }
    Serial.println("[DSP] Done.");
}

// ============================================================
// READ ENVIRONMENTAL SENSORS
// ============================================================
void read_environment(NodeData& data) {
    data.temperature = dht.readTemperature();
    data.humidity    = dht.readHumidity();
    data.gas_level   = analogRead(MQ2_PIN);

    // Handle DHT read failure
    if (isnan(data.temperature)) data.temperature = 0.0f;
    if (isnan(data.humidity))    data.humidity    = 0.0f;

    // Fire detection — hardware threshold (100% confidence)
    data.fire_alert = (data.temperature > TEMP_THRESHOLD) ||
                      (data.gas_level   > GAS_THRESHOLD);

    Serial.printf("[ENV] T:%.1fC H:%.1f%% Gas:%d %s\n",
                  data.temperature,
                  data.humidity,
                  data.gas_level,
                  data.fire_alert ? "⚠️ FIRE!" : "OK");
}

// ============================================================
// RUN AUDIO INFERENCE
// ============================================================
void run_audio_inference(NodeData& data) {
    // DSP — fills input tensor
    capture_and_process_audio();

    // Inference
    unsigned long t0 = millis();
    if (interpreter->Invoke() != kTfLiteOk) {
        Serial.println("[INF] Invoke failed");
        data.audio_class_id   = -1;
        data.audio_confidence = 0.0f;
        strncpy(data.audio_label, "ERROR", 15);
        return;
    }
    unsigned long t_ms = millis() - t0;

    // Dequantise output
    float scale      = output_tensor->params.scale;
    int   zero_point = output_tensor->params.zero_point;

    float best_conf = -999.0f;
    int   best_idx  = 0;
    float probs[3];

    for (int i = 0; i < 3; i++) {
        probs[i] = (output_tensor->data.int8[i] - zero_point) * scale;
        if (probs[i] > best_conf) {
            best_conf = probs[i];
            best_idx  = i;
        }
    }

    data.audio_class_id   = best_idx;
    data.audio_confidence = best_conf;
    strncpy(data.audio_label, CLASS_LABELS[best_idx], 15);

    Serial.printf("[INF] %s %.1f%% | Chainsaw:%.2f Env:%.2f Gun:%.2f | %lums\n",
                  data.audio_label, best_conf * 100,
                  probs[0], probs[1], probs[2], t_ms);
}

// ============================================================
// TRANSMIT VIA LORA
// Payload: ENV|NODE_ID|AUDIO_CLASS|CONF|T:xx|H:xx|G:xxxx
// ============================================================
void transmit(const NodeData& data) {
    char payload[64];

    // Fire alert overrides audio classification
    if (data.fire_alert) {
        snprintf(payload, sizeof(payload),
                 "ENV|N03|FIRE|1.00|T:%.1f|H:%.1f|G:%d",
                 data.temperature, data.humidity, data.gas_level);
    } else {
        snprintf(payload, sizeof(payload),
                 "ENV|N03|%s|%.2f|T:%.1f|H:%.1f|G:%d",
                 data.audio_label, data.audio_confidence,
                 data.temperature, data.humidity, data.gas_level);
    }

    LoRa.beginPacket();
    LoRa.print(payload);
    int ok = LoRa.endPacket();

    // Force back into receive mode
    LoRa.receive();

    Serial.printf("[LORA TX] %s | %s\n",
                  payload, ok ? "OK" : "FAILED");
}

// ============================================================
// SETUP
// ============================================================
void setup() {
    Serial.begin(115200);
    delay(1000);
    Serial.println("\n[SYS] Ambient Node Booting...");

    // Init order matters — LoRa first
    if (!init_lora()) {
        Serial.println("[SYS] FATAL: LoRa failed");
        while (1) delay(1000);
    }

    init_sensors();
    init_i2s();

    if (!init_tflite()) {
        Serial.println("[SYS] FATAL: TFLite failed");
        while (1) delay(1000);
    }

    Serial.printf("[SYS] Free heap:  %d bytes\n", ESP.getFreeHeap());
    Serial.printf("[SYS] Free PSRAM: %d bytes\n", ESP.getFreePsram());
    Serial.println("[SYS] Ready — starting main loop\n");

    // Give MQ2 sensor 2 seconds extra warmup
    Serial.println("[SYS] Waiting for MQ2 warmup...");
    delay(2000);
}

// ============================================================
// LOOP
// ============================================================
void loop() {
    Serial.println("\n[SYS] --- New Cycle ---");

    NodeData data;

    // 1. Read environment sensors
    read_environment(data);

    // 2. If fire detected — send immediately without waiting for audio
    if (data.fire_alert) {
        Serial.println("[ALERT] Fire conditions detected!");
        strncpy(data.audio_label, "FIRE", 15);
        data.audio_confidence = 1.0f;
        transmit(data);
        delay(3000);
        return;
    }

    // 3. Capture audio + run CRNN inference
    run_audio_inference(data);

    // 4. Transmit if threat detected
    bool audio_alert = (data.audio_class_id != 1) &&   // not environmental
                       (data.audio_confidence >= AUDIO_CONF_THRESH);

    if (audio_alert) {
        Serial.printf("[ALERT] %s detected!\n", data.audio_label);
        transmit(data);
    } else {
        Serial.printf("[SYS] Clear: %s %.1f%%\n",
                      data.audio_label, data.audio_confidence * 100);
    }

    // 5 second pause before next cycle
    delay(5000);
}
